# soc_system_hps_0_hps register map
Vendor: default_vendor.com; File version: 0.0
Registers are 32-bit, read-write, reset 0x0 unless marked. A register's access mark holds for its fields unless they carry their own. Offsets are from the block's base; [hi:lo] are bit positions.

## altera_avalon_pio_button_pio_s1
Base 0xFF200180
Same registers: altera_avalon_pio_hex5_pio_s1 0xFF200100, altera_avalon_pio_hex4_pio_s1 0xFF200110, altera_avalon_pio_hex3_pio_s1 0xFF200120, altera_avalon_pio_hex2_pio_s1 0xFF200130, altera_avalon_pio_hex1_pio_s1 0xFF200140, altera_avalon_pio_hex0_pio_s1 0xFF200150, altera_avalon_pio_led_pio_s1 0xFF200160, altera_avalon_pio_dipsw_pio_s1 0xFF200170
0x00 DATA — Reading from data returns the value present at the input ports. If the PIO core hardware is configured in output-only mode, reading from data returns an undefined value. Writing to data stores the value to a register that drives the output ports. If the PIO core hardware is configured in input-only mode, writing to data has no effect. If the PIO core hardware is in bidirectional mode, the registered value appears on an output port only when the corresponding bit in the direction register is set to 1 (output).
  [31:0] data — Reads: Data value currently on PIO inputs. Writes: New value to drive on PIO outputs.
0x04 DIRECTION — The direction register controls the data direction for each PIO port, assuming the port is bidirectional. When bit n in direction is set to 1, port n drives out the value in the corresponding bit of the data register The direction register only exists when the PIO core hardware is configured in bidirectional mode. The mode (input, output, or bidirectional) is specified at system generation time, and cannot be changed at runtime. In input-only or output-only mode, the direction register does not exist. In this case, reading direction returns an undefined value, writing direction has no effect. After reset, all bits of direction are 0, so that all bidirectional I/O ports are configured as inputs. If those PIO ports are connected to device pins, the pins are held in a high-impedance state. In bi-directional mode, to change the direction of the PIO port, reprogram the direction register.
  [31:0] direction — Individual direction control for each I/O port. A value of 0 sets the direction to input; 1 sets the direction to output.
0x08 IRQ_MASK — Setting a bit in the interruptmask register to 1 enables interrupts for the corresponding PIO input port. Interrupt behavior depends on the hardware configuration of the PIO core. The interruptmask register only exists when the hardware is configured to generate IRQs. If the core cannot generate IRQs, reading interruptmask returns an undefined value, and writing to interruptmask has no effect. After reset, all bits of interruptmask are zero, so that interrupts are disabled for all PIO ports.
  [31:0] interruptmask — IRQ enable/disable for each input port. Setting a bit to 1 enables interrupts for the corresponding port.
0x0C EDGE_CAP — Bit n in the edgecapture register is set to 1 whenever an edge is detected on input port n. An Avalon-MM master peripheral can read the edgecapture register to determine if an edge has occurred on any of the PIO input ports. If the option Enable bit-clearing for edge capture register is turned off, writing any value to the edgecapture register clears all bits in the register. Otherwise, writing a 1 to a particular bit in the register clears only that bit. The type of edge(s) to detect is fixed in hardware at system generation time. The edgecapture register only exists when the hardware is configured to capture edges. If the core is not configured to capture edges, reading from edgecapture returns an undefined value, and writing to edgecapture has no effect.
  [31:0] edgecapture — Edge detection for each input port.
0x10 SET_BIT wo — You can use the outset register to set individual bits of the output port. For example, to set bit 6 of the output port, write 0x40 to the outset register. This register is only present when the option Enable individual bit set/clear output register is turned on.
  [31:0] outset — Specifies which bit of the output port to set.
0x14 CLEAR_BITS wo — You can use the outclear register to clear individual bits of the output port. For example, writing 0x08 to the outclear register clears bit 3 of the output port. This register is only present when the option Enable individual bit set/clear output register is turned on.
  [31:0] outclear — Specifies which output bit to clear.
