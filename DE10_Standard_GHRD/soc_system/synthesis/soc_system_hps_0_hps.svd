# soc_system_hps_0_hps register map
Vendor: default_vendor.com; File version: 0.0
Address map for the HHP HPS system-domain
Registers are 32-bit, read-write, reset 0x0 unless marked. A register's access mark holds for its fields unless they carry their own. Offsets are from the block's base; lines under a group give offsets from that group; [hi:lo] are bit positions; {n}, {i} and the like mark numbered series; 'fields as' and 'values as' point back to an identical list; <NAME> marks a mode.

## Memory map
0xC0000000 altera_avalon_jtag_uart_jtag_uart_avalon_jtag_slave size 0x8
0xFC000000 stm size 0x4 — Address space allocated to the STM. For detailed information about the use of this address space, [url=http://infocenter.arm.com/help/index.jsp?topic=/com.arm.doc.ddi0444b/index.html]click here[/url] to access the ARM documentation for the CoreSight STM-101.
0xFF000000 dap size 0x4 — Address space allocated to the DAP. For detailed information about the use of this address space, [url=http://infocenter.arm.com/help/topic/com.arm.doc.ddi0314h/index.html]click here[/url] to access the ARM documentation for the DAP.
0xFF200000 lwfpgaslaves
0xFF200100 altera_avalon_pio_hex5_pio_s1 size 0x20
0xFF200110 altera_avalon_pio_hex4_pio_s1 size 0x20
0xFF200120 altera_avalon_pio_hex3_pio_s1 size 0x20
0xFF200130 altera_avalon_pio_hex2_pio_s1 size 0x20
0xFF200140 altera_avalon_pio_hex1_pio_s1 size 0x20
0xFF200150 altera_avalon_pio_hex0_pio_s1 size 0x20
0xFF200160 altera_avalon_pio_led_pio_s1 size 0x20
0xFF200170 altera_avalon_pio_dipsw_pio_s1 size 0x20
0xFF200180 altera_avalon_pio_button_pio_s1 size 0x20
0xFF200190 altera_avalon_sysid_sysid_qsys_control_slave size 0x8
0xFF220000 altera_avalon_jtag_uart_jtag_uart_avalon_jtag_slave size 0x8
0xFF400000 lwhps2fpgaregs size 0x4510C — Registers in the LWHPS2FPGA AXI Bridge Module.
0xFF500000 hps2fpgaregs size 0x410C — Registers in the HPS2FPGA AXI Bridge Module.
0xFF600000 fpga2hpsregs size 0x4410C — Registers in the FPGA2HPS AXI Bridge Module.
0xFF700000 emac0 size 0x105C — Registers in the EMAC module.
0xFF702000 emac1 size 0x105C — Registers in the EMAC module.
0xFF704000 sdmmc size 0x204 — Registers in the SD/MMC module
0xFF705000 qspiregs size 0x100 — Registers in the QSPI Flash Controller module accessible via its APB slave
0xFF706000 fpgamgrregs size 0x880 — Registers in the FPGA Manager module accessible via its APB slave
0xFF707000 acpidmap size 0x1000 — Registers in the ACP ID Mapper module
0xFF708000 gpio0 size 0x78 — Registers in the GPIO module
0xFF709000 gpio1 size 0x78 — Registers in the GPIO module
0xFF70A000 gpio2 size 0x78 — Registers in the GPIO module
0xFF800000 l3regs size 0x4C10C — Registers to control L3 interconnect settings
0xFF900000 nanddata
0xFFA00000 qspidata
0xFFB00000 usb0 size 0x40000 — Registers in the USB OTG Controller Module. Only the Core Global, Power and Clock Gating, Data FIFO Access, and Host Port registers can be accessedin both Host and Device modes. When the USB OTG Controller is operating in one mode, either Device or Host, the application must not access registers from the other mode. If an illegal access occurs, a Mode Mismatch interrupt is generated and reflected in the Core Interrupt register (GINTSTS.ModeMis). When the core switches from one mode to another, the registers in the new mode must be reprogrammed as they would be after a power-on reset. The register address map is fixed and does not depend on the module configuration (for example, how many endpoints are implemented). Host and Device mode registers occupy different addresses.
0xFFB40000 usb1 size 0x40000 — Registers in the USB OTG Controller Module. Only the Core Global, Power and Clock Gating, Data FIFO Access, and Host Port registers can be accessedin both Host and Device modes. When the USB OTG Controller is operating in one mode, either Device or Host, the application must not access registers from the other mode. If an illegal access occurs, a Mode Mismatch interrupt is generated and reflected in the Core Interrupt register (GINTSTS.ModeMis). When the core switches from one mode to another, the registers in the new mode must be reprogrammed as they would be after a power-on reset. The register address map is fixed and does not depend on the module configuration (for example, how many endpoints are implemented). Host and Device mode registers occupy different addresses.
0xFFB80000 nandregs size 0x7A4 — Registers in the NAND Flash Controller module accessible via its register AXI slave
0xFFB90000 fpgamgrdata size 0x4 — Registers in the FPGA Manager module accessible via its AXI slave
0xFFC00000 can0 size 0x200 — Registers in the CAN Controller module NOTE: These descriptions apply only to SoC devices that support the CAN module.
0xFFC01000 can1 size 0x200 — Registers in the CAN Controller module NOTE: These descriptions apply only to SoC devices that support the CAN module.
0xFFC02000 uart0 size 0x100 — Registers in the UART module
0xFFC03000 uart1 size 0x100 — Registers in the UART module
0xFFC04000 i2c0 size 0x100 — Registers in the I2C module
0xFFC05000 i2c1 size 0x100 — Registers in the I2C module
0xFFC06000 i2c2 size 0x100 — Registers in the I2C module
0xFFC07000 i2c3 size 0x100 — Registers in the I2C module
0xFFC08000 sptimer0 size 0xB0 — Registers in the timer module. The timer IP core supports multiple timers but it is configured for just one timer. The term Timer1 refers to this one timer in the IP core and not the module instance.
0xFFC09000 sptimer1 size 0xB0 — Registers in the timer module. The timer IP core supports multiple timers but it is configured for just one timer. The term Timer1 refers to this one timer in the IP core and not the module instance.
0xFFC20000 sdr size 0x20000 — Address map for the SDRAM Interface registers
0xFFD00000 osc1timer0 size 0xB0 — Registers in the timer module. The timer IP core supports multiple timers but it is configured for just one timer. The term Timer1 refers to this one timer in the IP core and not the module instance.
0xFFD01000 osc1timer1 size 0xB0 — Registers in the timer module. The timer IP core supports multiple timers but it is configured for just one timer. The term Timer1 refers to this one timer in the IP core and not the module instance.
0xFFD02000 l4wd0 size 0x100 — Registers in the L4 Watchdog module
0xFFD03000 l4wd1 size 0x100 — Registers in the L4 Watchdog module
0xFFD04000 clkmgr size 0x200 — Registers in the Clock Manager module
0xFFD05000 rstmgr size 0x100 — Registers in the Reset Manager module
0xFFD08000 sysmgr size 0x4000 — Registers in the System Manager module
0xFFE00000 dmanonsecure size 0x4 — Address space allocated to the nonsecure DMA. For detailed information about the use of this address space, [url=http://infocenter.arm.com/help/topic/com.arm.doc.ddi0424b/index.html]click here[/url] to access the ARM documentation for the DMA-330.
0xFFE01000 dmasecure size 0x4 — Address space allocated to the secure DMA. For detailed information about the use of this address space, [url=http://infocenter.arm.com/help/topic/com.arm.doc.ddi0424b/index.html]click here[/url] to access the ARM documentation for the DMA-330.
0xFFE02000 spis0 size 0x64 — Registers in the SPI Slave module
0xFFE03000 spis1 size 0x64 — Registers in the SPI Slave module
0xFFF00000 spim0 size 0x100 — Registers in the SPI Master module
0xFFF01000 spim1 size 0x100 — Registers in the SPI Master module
0xFFF02000 scanmgr size 0x20 — Registers in the Scan Manager module. These registers are implemented by an ARM JTAG-AP module from the ARM DAP. Some register and field names have been changed to match the usage in the Scan Manager. If modified, the corresponding names from the ARM documentation are provided. Only registers and fields that are relevant to the JTAG-AP use in the Scan Manager are listed.
0xFFFD0000 rom
0xFFFEC000 mpuscu size 0x4 — Address space allocated to the MPU SCU. For detailed information about the use of this address space, [url=http://infocenter.arm.com/help/topic/com.arm.doc.ddi0407f/index.html]click here[/url] to access the ARM documentation for the Cortex-A9 MPCore.
0xFFFEF000 mpul2 size 0x4 — Address space allocated to the MPU L2 cache controller. For detailed information about the use of this address space, [url=http://infocenter.arm.com/help/topic/com.arm.doc.ddi0246e/index.html]click here[/url] to access the ARM documentation for the L2C-301.
0xFFFF0000 ocram
